## Kconfig
```kconfig
mainmenu "Pyxis Configuration"

menu "Caelum"

config NPFS_FLUSH_SECONDS
  int "npfs background flush interval (seconds)"
  range 1 4294967
  default 30
  help
    Flush all dirty npfs data and pending FAT32 batches periodically. This
    interval is nominal: a flush can take longer under load. File, directory
    and mount synchronization operations provide the explicit durability guarantees.

config FAT32_BATCH_MIB
  int "FAT32 pending sector image target (MiB)"
  range 1 64
  default 4
  help
    Retain this many MiB of sector images per writable FAT32 mount before
    checkpointing. Metadata and quarantine backing are additional. Larger
    individual operations checkpoint synchronously; this is not a file limit.

config HPET_MAINTENANCE_TICKS
  int "HPET maintenance interval (BSP timer ticks)"
  range 1 4294967295
  default 120
  help
    Sample a software-extended 32-bit HPET after this many delivered BSP
    LAPIC timer interrupts. The current 120 Hz timer makes 120 ticks
    nominally one second. Direct 64-bit HPET counters need no maintenance.

    Choose an interval well below the hardware counter's wrap time.
    Initialization rejects a nominal interval of one wrap or longer.
    Interrupt delays also count toward the less-than-one-wrap sampling
    requirement; elapsed time always comes from HPET, not timer ticks.

config INTEL_INHERITED_FLIP
  bool "Intel inherited-mode synchronized flips"
  default y
  help
    Prepare fixed owned UMA/GGTT backs for the qualified inherited Intel pipe.
    Keeps DC0 while active; no modesetting. display.flip=0 forces copying;
    refused admission falls back to copying when ownership is confirmed.

config XHCI
  bool "XHCI"
  default y
  help
    Enable native xHCI controller preparation and USB enumeration.
    Enable boot-present device inventory and qualified USB storage access.

config HID_I2C_POLL_MS
  int "HID-over-I2C polling interval (ms)"
  range 1 1000
  default 4
  help
    Tunable BSP transport interval. Native report-rate qualification chooses
    the default; bounded draining and sleeping preserve other workers.

config HID_I2C_MEASURE
  bool "Finite HID-over-I2C native rate/cost measurement"
  default n
  help
    After two minutes, measure baseline/idle, four ten-second moving-finger
    intervals (8/4/2/1 ms), and final idle. Print finite summaries only.
    Service time times poll rate is an estimate, excluding scheduler/cache
    effects. No scheduler probe or permanent report stream.
    This changes the polling cadence; use only for native qualification.

config TOUCHPAD_TYPING_MS
  int "Synaptics new-contact typing quiet interval (ms)"
  range 50 100
  default 75
  help
    New contacts that begin during typing retry after this quiet interval.
    Already admitted contacts are unaffected. Owner-accepted, revisitable tuning.

config TOUCHPAD_SCROLL_ENTER_MM
  int "Synaptics two-finger scroll entry distance (mm)"
  range 1 150
  default 25
  help
    Scroll from the centroid when a fresh pair is this close or closer.
    Owner-accepted, revisitable tuning; leave distance must be greater.

config TOUCHPAD_SCROLL_LEAVE_MM
  int "Synaptics two-finger scroll leave distance (mm)"
  range 1 150
  default 30
  help
    Stop scrolling when separation reaches this distance.
    Owner-accepted, revisitable tuning; must exceed the entry distance.

config TOUCHPAD_PAIR_FRESH_MS
  int "Synaptics paired-position freshness (ms)"
  range 1 1000
  default 50
  help
    Both receipt timestamps must be within this age to use a pair.
    Owner-accepted, revisitable tuning; stale input resets motion baselines.

config TOUCHPAD_BUTTON_MOVE_MM
  int "HID clickpad button-contact pointer displacement (mm)"
  range 1 1000
  default 3
  help
    A zone contact moving farther than this from touchdown before any physical
    press becomes a pointer contact until lift. A contact seen during a press
    cannot promote by displacement. Owner-accepted, revisitable tuning.

config TOUCHPAD_CLICK_PAIR_MS
  int "HID clickpad paired-click touchdown window (ms)"
  range 1 1000
  default 100
  help
    Maximum touchdown separation for a stationary two-finger secondary press
    involving the primary button zone. Owner-accepted, revisitable tuning.

config TOUCHPAD_CLICK_PRESS_MS
  int "HID clickpad paired-click press window (ms)"
  range 1 1000
  default 300
  help
    Maximum time from the later touchdown to a qualifying physical press.
    Selection is immediate and stays latched until physical release.

config TOUCHPAD_CLICK_STILL_MM
  int "HID clickpad stationary paired-click displacement (mm)"
  range 1 1000
  default 1
  help
    Each contact must stay within this distance from touchdown for paired-click
    initial secondary selection. Missing/uncertain history keeps primary; no
    added wait.

config TOUCHPAD_CLICK_HOLD_MM
  int "HID clickpad qualified-pair displacement (mm)"
  range 1 1000
  default 3
  help
    After a pair first selects secondary, each contact may move this far from
    its position at that qualification while retaining secondary for later
    presses. Exceeding the distance or lifting either contact clears it.
    Later presses do not move the anchors. The held button stays latched until
    physical release. Owner-accepted, revisitable tuning.

endmenu
```
